## boards/shields/hwelora/Kconfig.defconfig
```kconfig
if SHIELD_HWELORA_DONGLE

config ZMK_KEYBOARD_NAME
    default "HW Elora"

config ZMK_SPLIT_ROLE_CENTRAL
    default y

endif

if SHIELD_HWELORA_DONGLE || SHIELD_HWELORA_LEFT || SHIELD_HWELORA_RIGHT

config ZMK_SPLIT
    default y

endif
```

## boards/shields/hwelora/Kconfig.shield
```kconfig
config SHIELD_HWELORA_DONGLE
	def_bool $(shields_list_contains,hwelora_dongle)
	
config SHIELD_HWELORA_LEFT
    def_bool $(shields_list_contains,hwelora_left)

config SHIELD_HWELORA_RIGHT
    def_bool $(shields_list_contains,hwelora_right)
```

## config/west.yml
```yaml
manifest:
  remotes:
    - name: zmkfirmware
      url-base: https://github.com/zmkfirmware
    # Additional modules containing boards/shields/custom code can be listed here as well
    # See https://docs.zephyrproject.org/3.2.0/develop/west/manifest.html#projects
    - name: zzeneg
      url-base: https://github.com/zzeneg
  projects:
    - name: zmk
      remote: zmkfirmware
      revision: v0.3
      import: app/west.yml
    - name: zmk-raw-hid
      remote: zzeneg
      revision: main
  self:
    path: config
```
